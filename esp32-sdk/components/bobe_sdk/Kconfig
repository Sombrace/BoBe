## esp32-sdk/components/bobe_sdk/Kconfig
```kconfig
menu "BoBe voice runtime"

config BOBE_ENABLE_TEXT_INPUT
    bool "Keyboard/text input on the voice body"
    default n
    help
        Requires owner enrollment granting text_input and BodyLink minor 2.

config BOBE_ENABLE_TEXT_OUTPUT
    bool "Plain-text output callback on the voice body"
    default n
    help
        Register esp_bobe_set_event_handler before starting the runtime.
        Requires owner enrollment granting text_output and BodyLink minor 2.

config BOBE_ENABLE_ACTION_INPUT
    bool "Application action buttons on the voice body"
    default n

config BOBE_ENABLE_SENSOR_REPORTS
    bool "Application sensor reports on the voice body"
    default n

config BOBE_BODY_ENDPOINT_URI
    string "BodyLink WebSocket URI"
    default ""
    help
        Use wss:// for real deployments. An empty value keeps the body in
        offline mode while board, display, audio, and controls remain active.

config BOBE_ENABLE_DEV_WIFI_BOOTSTRAP
    bool "Embed development Wi-Fi credentials"
    default n
    help
        Development-only bootstrap for seeding Wi-Fi NVS on a test device.
        Product builds must keep this disabled.

config BOBE_WIFI_SSID
    string "Development Wi-Fi SSID"
    default ""
    depends on BOBE_ENABLE_DEV_WIFI_BOOTSTRAP
    help
        Development-only bootstrap. Product builds use secure provisioning.
        The generated sdkconfig is ignored and must never be committed.

config BOBE_WIFI_PASSWORD
    string "Development Wi-Fi password"
    default ""
    depends on BOBE_ENABLE_DEV_WIFI_BOOTSTRAP
    help
        Development-only bootstrap. Product builds use secure provisioning.
        The generated sdkconfig is ignored and must never be committed.

config BOBE_ALLOW_INSECURE_WS
    bool "Allow unencrypted ws:// endpoints"
    default n
    help
        Development escape hatch. Production must use authenticated TLS.

config BOBE_ENABLE_ESP_SR
    bool "Enable ESP-SR audio front end"
    default n
    help
        Enables the optional AFE, VAD, pre-roll, and WakeNet edge profile.

config BOBE_ENABLE_SECURE_PROVISIONING
    bool "Enable Security 2 provisioning"
    default n
    select ESP_PROTOCOMM_SUPPORT_SECURITY_VERSION_2
    help
        Requires per-device Security 2 credentials generated with
        tools/generate_provisioning_credentials.sh. The generated source and
        password manifest stay under private/ and are never committed.

choice BOBE_PROVISIONING_TRANSPORT
    prompt "Security 2 provisioning transport"
    default BOBE_PROVISIONING_TRANSPORT_SOFTAP
    depends on BOBE_ENABLE_SECURE_PROVISIONING

config BOBE_PROVISIONING_TRANSPORT_SOFTAP
    bool "WPA2 SoftAP and HTTP"
    help
        Starts a per-device WPA2 SoftAP for provisioning. Select the
        transport supported by your board and provisioning client.

config BOBE_PROVISIONING_TRANSPORT_BLE
    bool "Bluetooth LE"
    select BT_ENABLED
    help
        Use NimBLE provisioning on hardware with a verified BLE radio.
        BT_HOST is a Kconfig choice and cannot be selected here; include
        a board-specific defaults file with CONFIG_BT_NIMBLE_ENABLED=y.

endchoice

config BOBE_PROVISIONING_WINDOW_SECONDS
    int "Provisioning window duration"
    range 60 1800
    default 600
    depends on BOBE_ENABLE_SECURE_PROVISIONING

config BOBE_BUILD_NUMBER
    int "Monotonic firmware build number"
    range 1 2147483647
    default 2
    help
        Must increase for every firmware release. Signed OTA manifests with an
        equal or lower build number are rejected before download.

config BOBE_UI_FPS
    int "Maximum active face frame rate"
    range 15 60
    default 30

config BOBE_AUDIO_PLAYBACK_CREDIT_MS
    int "Maximum queued playback audio in milliseconds"
    range 120 300
    default 300

endmenu
```

## esp32-sdk/examples/sensor_node/main/Kconfig.projbuild
```kconfig
menu "BoBe sensor example"
config BOBE_EXAMPLE_BUTTON_GPIO
    int "Optional active-low button GPIO (-1 disables)"
    range -1 48
    default -1
    help
        Select an input-capable GPIO appropriate for your board. Check its
        pinout and avoid pins used by flash, PSRAM, or other peripherals.
config BOBE_EXAMPLE_BUTTON_LABEL
    string "Meaning of the button action"
    default "Give me a brief update"
endmenu
```

## esp32-sdk/examples/text_terminal/sdkconfig.defaults
```kconfig
CONFIG_COMPILER_OPTIMIZATION_SIZE=y
CONFIG_ESP_MAIN_TASK_STACK_SIZE=8192
CONFIG_MBEDTLS_SSL_PROTO_TLS1_3=y
CONFIG_MBEDTLS_HAVE_TIME_DATE=y
CONFIG_EXAMPLE_CONNECT_IPV6=n
CONFIG_EXAMPLE_WIFI_SSID=""
CONFIG_EXAMPLE_WIFI_PASSWORD=""
```

## esp32-sdk/examples/wb12/sdkconfig.defaults
```kconfig
CONFIG_COMPILER_OPTIMIZATION_PERF=y
CONFIG_ESP_DEFAULT_CPU_FREQ_MHZ_240=y
CONFIG_PM_ENABLE=y
CONFIG_FREERTOS_USE_TICKLESS_IDLE=n
CONFIG_PM_POWER_DOWN_CPU_IN_LIGHT_SLEEP=n
CONFIG_ESP_TASK_WDT_EN=y
CONFIG_ESP_TASK_WDT_TIMEOUT_S=8
CONFIG_ESP_TASK_WDT_PANIC=y
CONFIG_I2S_ISR_IRAM_SAFE=y
CONFIG_FREERTOS_HZ=1000
CONFIG_LOG_DEFAULT_LEVEL_INFO=y
CONFIG_APP_RETRIEVE_LEN_ELF_SHA=64
CONFIG_BOBE_BUILD_NUMBER=2

CONFIG_ESPTOOLPY_FLASHSIZE_16MB=y
CONFIG_ESPTOOLPY_FLASHMODE_DIO=y
CONFIG_ESPTOOLPY_FLASHFREQ_80M=y

CONFIG_PARTITION_TABLE_CUSTOM=y
CONFIG_PARTITION_TABLE_CUSTOM_FILENAME="partitions.csv"
CONFIG_PARTITION_TABLE_OFFSET=0x8000
CONFIG_BOOTLOADER_APP_ROLLBACK_ENABLE=y
CONFIG_ESP_COREDUMP_ENABLE_TO_FLASH=y

CONFIG_SPIRAM=y
CONFIG_SPIRAM_MODE_OCT=y
CONFIG_SPIRAM_SPEED_80M=y
CONFIG_SPIRAM_USE_MALLOC=y
CONFIG_SPIRAM_MALLOC_ALWAYSINTERNAL=16384
CONFIG_SPIRAM_MALLOC_RESERVE_INTERNAL=65536
CONFIG_SPIRAM_TRY_ALLOCATE_WIFI_LWIP=y
CONFIG_FREERTOS_TASK_CREATE_ALLOW_EXT_MEM=y

CONFIG_ESP_WIFI_STATIC_RX_BUFFER_NUM=8
CONFIG_ESP_WIFI_DYNAMIC_RX_BUFFER_NUM=16
CONFIG_ESP_WIFI_STATIC_TX_BUFFER=y
CONFIG_ESP_WIFI_STATIC_TX_BUFFER_NUM=16
CONFIG_ESP_WIFI_ENABLE_WPA3_OWE_SOFTAP=n
CONFIG_HTTPD_ENABLE_EVENTS=n
CONFIG_LWIP_MAX_SOCKETS=12
CONFIG_LWIP_SNTP_MAX_SERVERS=3
CONFIG_MDNS_TASK_CREATE_FROM_SPIRAM=y
CONFIG_MDNS_ENABLE_BROWSE=n

CONFIG_MBEDTLS_SSL_PROTO_TLS1_3=y
CONFIG_MBEDTLS_HAVE_TIME_DATE=y
CONFIG_CJSON_NESTING_LIMIT=16

CONFIG_ESP_CONSOLE_USB_SERIAL_JTAG=y
CONFIG_ESP_CONSOLE_SECONDARY_NONE=y

CONFIG_LV_COLOR_FORMAT_RGB565=y
CONFIG_LV_USE_CUSTOM_MALLOC=y
CONFIG_LV_USE_LOG=n
CONFIG_LV_USE_ASSERT=y
CONFIG_LV_USE_ASSERT_NULL=y
CONFIG_LV_USE_ASSERT_MALLOC=y
CONFIG_LV_USE_THEME_DEFAULT=n
CONFIG_LV_USE_THEME_MONO=n
CONFIG_LV_FONT_MONTSERRAT_14=y
CONFIG_LV_FONT_MONTSERRAT_18=y
CONFIG_LV_BUILD_EXAMPLES=n
CONFIG_LV_BUILD_DEMOS=n
```
